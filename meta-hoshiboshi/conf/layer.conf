## meta-hoshiboshi/conf/layer.conf
```bitbake
# We have a conf and classes directory, add to BBPATH
BBPATH .= ":${LAYERDIR}"

# We have recipes-* directories, add to BBFILES
BBFILES += "${LAYERDIR}/recipes-*/*/*.bb \
            ${LAYERDIR}/recipes-*/*/*.bbappend"

BBFILE_COLLECTIONS += "meta-hoshiboshi"
BBFILE_PATTERN_meta-hoshiboshi = "^${LAYERDIR}/"
BBFILE_PRIORITY_meta-hoshiboshi = "6"

LAYERDEPENDS_meta-hoshiboshi = "core"
LAYERSERIES_COMPAT_meta-hoshiboshi = "warrior zeus hardknott"
```
